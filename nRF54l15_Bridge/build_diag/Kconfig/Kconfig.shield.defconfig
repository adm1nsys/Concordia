## nRF54l15_Bridge/build_diag/Kconfig/boards/Kconfig.sysbuild.tmp
```kconfig
# Load Sysbuild board Kconfig descriptions.
osource "/opt/nordic/ncs/v3.4.0/zephyr/boards/seeed/xiao_nrf54l15/Kconfig.sysbuild"
```

## nRF54l15_Bridge/build_diag/Kconfig/boards/Kconfig.xiao_nrf54l15.tmp
```kconfig
# Load board Kconfig descriptions.
osource "/opt/nordic/ncs/v3.4.0/zephyr/boards/seeed/xiao_nrf54l15/Kconfig.xiao_nrf54l15"
```
